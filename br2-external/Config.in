## br2-external/Config.in
```kconfig
source "$BR2_EXTERNAL_KL_AM62X_PATH/package/pipewire-milan/Config.in"
source "$BR2_EXTERNAL_KL_AM62X_PATH/package/pipewire-upstream/Config.in"
source "$BR2_EXTERNAL_KL_AM62X_PATH/package/milan-fpga-src/Config.in"
source "$BR2_EXTERNAL_KL_AM62X_PATH/package/milan-bridge/Config.in"
```

## br2-external/configs/myir_am62x_avb_defconfig
```kconfig
BR2_aarch64=y
BR2_cortex_a53=y
BR2_ARM_FPU_VFPV4=y
BR2_TOOLCHAIN_BUILDROOT_CXX=y
BR2_OPTIMIZE_2=y
BR2_ROOTFS_DEVICE_CREATION_DYNAMIC_EUDEV=y
BR2_ROOTFS_MERGED_USR=y
BR2_TARGET_GENERIC_ROOT_PASSWD="root"
BR2_SYSTEM_BIN_SH_BASH=y
BR2_PACKAGE_BASH=y
BR2_TARGET_GENERIC_GETTY_PORT="ttyS7"
BR2_ROOTFS_OVERLAY="$(BR2_EXTERNAL_KL_AM62X_PATH)/board/myir-am62x/rootfs-overlay"
BR2_ROOTFS_POST_BUILD_SCRIPT="$(BR2_EXTERNAL_KL_AM62X_PATH)/board/myir-am62x/post-build.sh"
BR2_PACKAGE_PIPEWIRE_MILAN=y
BR2_PACKAGE_LINUXPTP=y
BR2_PACKAGE_ALSA_UTILS=y
BR2_PACKAGE_ALSA_UTILS_APLAY=y
BR2_PACKAGE_ETHTOOL=y
BR2_PACKAGE_IPROUTE2=y
BR2_PACKAGE_LIBCAP=y
BR2_PACKAGE_LIBCAP_TOOLS=y
BR2_PACKAGE_OPENSSH=y
BR2_PACKAGE_USBUTILS=y
BR2_PACKAGE_RT_TESTS=y
BR2_PACKAGE_STRESS_NG=y
BR2_TARGET_ROOTFS_EXT2=y
BR2_TARGET_ROOTFS_EXT2_4=y
BR2_TARGET_ROOTFS_EXT2_SIZE="2G"
BR2_TARGET_ROOTFS_TAR_GZIP=y
```

## br2-external/package/flexptp-gptp/Config.in
```kconfig
config BR2_PACKAGE_FLEXPTP_GPTP
	bool "flexptp-gptp (IEEE 802.1AS end station)"
	depends on BR2_TOOLCHAIN_HAS_THREADS
	help
	  flexptpd, the PocketBeagle 2's gPTP: our fork of flexPTP with an
	  IEEE 802.1AS-2020 time-aware end station (peer delay with
	  neighborRateRatio and asCapable, the 802.1AS BMCA, signaling)
	  and Avnu's reverse sync, as a Linux daemon on a PHC with
	  hardware timestamps. It publishes the port's state in
	  /dev/shm/flexptpd.<interface>, which the bridge reads.

	  Built at the revision package/flexptp-gptp/flexptp.pin names.

	  https://github.com/kebag-logic/flexPTP

comment "flexptp-gptp needs a toolchain with threads"
	depends on !BR2_TOOLCHAIN_HAS_THREADS
```

## br2-external/package/milan-bridge/Config.in
```kconfig
config BR2_PACKAGE_MILAN_BRIDGE
	bool "milan-bridge (PocketBeagle 2 USB-to-Milan bridge)"
	depends on BR2_TOOLCHAIN_HAS_THREADS
	select BR2_PACKAGE_MILAN_FPGA_SRC
	select BR2_PACKAGE_LINUXPTP
	select BR2_PACKAGE_ALSA_LIB
	help
	  The daemons of the PocketBeagle 2 USB-to-Milan bridge, from
	  milan-linux/ in this BSP: milan-ctrld, the Milan control plane
	  (milan-fpga's Mark II control-plane firmware, unchanged, on a
	  soft fabric over AF_PACKET, netlink and ptp4l's management
	  socket); milan-mediad, the media plane (the AAF talker fed by the
	  UAC2 gadget, on the media clock, with the servo that steers the
	  USB host); and milan-dp, which prints what both publish. Started
	  by S95avb with AVB_STACK=native through /usr/sbin/milan-bridge.sh.
	  See README.pb2-tsn.md.

comment "milan-bridge needs a toolchain with threads"
	depends on !BR2_TOOLCHAIN_HAS_THREADS
```

## br2-external/package/milan-fpga-src/Config.in
```kconfig
config BR2_PACKAGE_MILAN_FPGA_SRC
	bool
	help
	  The milan-fpga tree at the revision milan-linux/milan-fpga.pin
	  names, unpacked for the packages that compile its sources (the
	  Mark II control-plane firmware). Installs nothing.

	  https://github.com/kebag-logic/milan-fpga
```

## br2-external/package/pipewire-milan/Config.in
```kconfig
config BR2_PACKAGE_PIPEWIRE_MILAN
	bool "pipewire-milan (AVB/Milan fork)"
	depends on BR2_TOOLCHAIN_HAS_THREADS
	depends on BR2_TOOLCHAIN_HAS_SYNC_4
	depends on !BR2_PACKAGE_PIPEWIRE
	select BR2_PACKAGE_ALSA_LIB
	select BR2_PACKAGE_LINUXPTP
	help
	  PipeWire built from the Milan AVB fork (gitlab Mister-M-alt/pipewire)
	  with the module-avb / Milan support enabled. Installs /usr/bin/pipewire
	  so it conflicts with the stock pipewire package (disable that one).

	  Alternative: keep stock pipewire and deploy the Milan build at runtime
	  with the pipewire-helper build-and-install script instead of this package.

comment "pipewire-milan needs threads and conflicts with the stock pipewire package"
	depends on !BR2_TOOLCHAIN_HAS_THREADS || BR2_PACKAGE_PIPEWIRE
```

## br2-external/package/pipewire-upstream/Config.in
```kconfig
config BR2_PACKAGE_PIPEWIRE_UPSTREAM
	bool "pipewire-upstream (official master)"
	depends on BR2_TOOLCHAIN_HAS_THREADS
	depends on BR2_TOOLCHAIN_HAS_SYNC_4
	depends on !BR2_PACKAGE_PIPEWIRE
	depends on !BR2_PACKAGE_PIPEWIRE_MILAN
	select BR2_PACKAGE_ALSA_LIB
	select BR2_PACKAGE_DBUS
	help
	  PipeWire built from the official upstream master
	  (gitlab.freedesktop.org/pipewire/pipewire) with module-avb enabled.
	  Installs /usr/bin/pipewire, so it conflicts with the stock pipewire
	  and pipewire-milan packages (enable exactly one).

	  module-avb reads gPTP from a ptp4l-style management socket: the
	  board's defconfig brings the gPTP daemon (BR2_PACKAGE_LINUXPTP on
	  the MYIR and SK boards; the PocketBeagle 2 runs flexptpd instead).

comment "pipewire-upstream needs threads and conflicts with stock pipewire / pipewire-milan"
	depends on !BR2_TOOLCHAIN_HAS_THREADS || BR2_PACKAGE_PIPEWIRE || BR2_PACKAGE_PIPEWIRE_MILAN
```

## pb2_rootfs_br_defconfig
```kconfig
BR2_aarch64=y
BR2_ARM_FPU_VFPV4=y
BR2_PACKAGE_GLIBC_KERNEL_COMPAT=y
BR2_GCC_VERSION_15_X=y
BR2_TOOLCHAIN_BUILDROOT_CXX=y
BR2_TOOLCHAIN_BUILDROOT_FORTRAN=y
BR2_GCC_ENABLE_OPENMP=y
BR2_GCC_ENABLE_GRAPHITE=y
BR2_ROOTFS_DEVICE_CREATION_DYNAMIC_EUDEV=y
BR2_ROOTFS_MERGED_USR=y
BR2_TARGET_GENERIC_ROOT_PASSWD="root"
BR2_TARGET_TZ_INFO=y
BR2_PACKAGE_BUSYBOX_SHOW_OTHERS=y
BR2_PACKAGE_PIPEWIRE=y
BR2_PACKAGE_PIPEWIRE_COMPRESS_OFFLOAD=y
BR2_PACKAGE_PIPEWIRE_EXAMPLES=y
BR2_PACKAGE_PIPEWIRE_GSTREAMER=y
BR2_PACKAGE_PIPEWIRE_V4L2=y
BR2_PACKAGE_PIPEWIRE_MEDIA_SESSION=y
BR2_PACKAGE_BCC=y
BR2_PACKAGE_BPFTOOL=y
BR2_PACKAGE_HYPERFINE=y
BR2_PACKAGE_KEXEC=y
BR2_PACKAGE_KEXEC_ZLIB=y
BR2_PACKAGE_LIBBPF=y
BR2_PACKAGE_LIBTRACEFS=y
BR2_PACKAGE_NETPERF=y
BR2_PACKAGE_PV=y
BR2_PACKAGE_RT_TESTS=y
BR2_PACKAGE_STRACE=y
BR2_PACKAGE_STRESS_NG=y
BR2_PACKAGE_VALGRIND=y
BR2_PACKAGE_DT_UTILS=y
BR2_PACKAGE_EUDEV_RULES_GEN=y
BR2_PACKAGE_EVTEST=y
BR2_PACKAGE_FWUPD=y
BR2_PACKAGE_FWUPD_EFI=y
BR2_PACKAGE_HDDTEMP=y
BR2_PACKAGE_HDPARM=y
BR2_PACKAGE_HWDATA=y
BR2_PACKAGE_I2C_TOOLS=y
BR2_PACKAGE_IOTOOLS=y
BR2_PACKAGE_KBD=y
BR2_PACKAGE_LM_SENSORS=y
BR2_PACKAGE_MEMTOOL=y
BR2_PACKAGE_PCIUTILS=y
BR2_PACKAGE_POWERTOP=y
BR2_PACKAGE_PPS_TOOLS=y
BR2_PACKAGE_USBMOUNT=y
BR2_PACKAGE_USBUTILS=y
BR2_PACKAGE_MPFR=y
BR2_PACKAGE_BC=y
BR2_PACKAGE_AARDVARK_DNS=y
BR2_PACKAGE_CHRONY=y
BR2_PACKAGE_DHCP=y
BR2_PACKAGE_DHCPCD=y
BR2_PACKAGE_EASYFRAMES=y
BR2_PACKAGE_IFPLUGD=y
BR2_PACKAGE_IPTABLES=y
BR2_PACKAGE_NET_TOOLS=y
BR2_PACKAGE_NETCAT=y
BR2_PACKAGE_NTP=y
BR2_PACKAGE_OPENSSH=y
BR2_PACKAGE_TCPDUMP=y
BR2_PACKAGE_BASH=y
BR2_PACKAGE_HTOP=y
BR2_PACKAGE_KMOD_TOOLS=y
BR2_PACKAGE_UTIL_LINUX_AGETTY=y
BR2_PACKAGE_UTIL_LINUX_FSCK=y
BR2_PACKAGE_UTIL_LINUX_MOUNT=y
BR2_PACKAGE_UTIL_LINUX_SULOGIN=y
BR2_PACKAGE_LESS=y
BR2_PACKAGE_MOST=y
BR2_PACKAGE_VIM=y
BR2_TARGET_ROOTFS_CPIO=y
BR2_TARGET_ROOTFS_EXT2=y
BR2_TARGET_ROOTFS_EXT2_4=y
BR2_PACKAGE_HOST_KMOD=y
```

## res/pb2_rootfs_br_defconfig
```kconfig
BR2_aarch64=y
BR2_ARM_FPU_VFPV4=y
BR2_PACKAGE_GLIBC_KERNEL_COMPAT=y
BR2_PACKAGE_GLIBC_UTILS=y
BR2_GCC_VERSION_15_X=y
BR2_TOOLCHAIN_BUILDROOT_CXX=y
BR2_TOOLCHAIN_BUILDROOT_FORTRAN=y
BR2_GCC_ENABLE_OPENMP=y
BR2_GCC_ENABLE_GRAPHITE=y
BR2_OPTIMIZE_3=y
BR2_ROOTFS_DEVICE_CREATION_DYNAMIC_EUDEV=y
BR2_ROOTFS_MERGED_USR=y
BR2_TARGET_GENERIC_ROOT_PASSWD="root"
BR2_SYSTEM_BIN_SH_BASH=y
BR2_TARGET_TZ_INFO=y
BR2_PACKAGE_BUSYBOX_SHOW_OTHERS=y
BR2_PACKAGE_ALSA_UTILS=y
BR2_PACKAGE_ALSA_UTILS_APLAY=y
BR2_PACKAGE_ALSA_UTILS_SPEAKER_TEST=y
BR2_PACKAGE_FLAC=y
BR2_PACKAGE_PIPEWIRE=y
BR2_PACKAGE_PIPEWIRE_COMPRESS_OFFLOAD=y
BR2_PACKAGE_PIPEWIRE_EXAMPLES=y
BR2_PACKAGE_PIPEWIRE_GSTREAMER=y
BR2_PACKAGE_PIPEWIRE_V4L2=y
BR2_PACKAGE_PIPEWIRE_MEDIA_SESSION=y
BR2_PACKAGE_GZIP=y
BR2_PACKAGE_LRZIP=y
BR2_PACKAGE_LZIP=y
BR2_PACKAGE_PIXZ=y
BR2_PACKAGE_ZSTD=y
BR2_PACKAGE_BPFTOOL=y
BR2_PACKAGE_BPFTRACE=y
BR2_PACKAGE_HYPERFINE=y
BR2_PACKAGE_KEXEC=y
BR2_PACKAGE_KEXEC_ZLIB=y
BR2_PACKAGE_LIBTRACEFS=y
BR2_PACKAGE_LSOF=y
BR2_PACKAGE_NETPERF=y
BR2_PACKAGE_PV=y
BR2_PACKAGE_RT_TESTS=y
BR2_PACKAGE_STRACE=y
BR2_PACKAGE_STRESS_NG=y
BR2_PACKAGE_VALGRIND=y
BR2_PACKAGE_BINUTILS_TARGET=y
BR2_PACKAGE_DIFFUTILS=y
BR2_PACKAGE_GIT=y
BR2_PACKAGE_GREP=y
BR2_PACKAGE_MAKE=y
BR2_PACKAGE_MAWK=y
BR2_PACKAGE_PATCH=y
BR2_PACKAGE_PKGCONF=y
BR2_PACKAGE_SED=y
BR2_PACKAGE_TREE=y
BR2_PACKAGE_DT_UTILS=y
BR2_PACKAGE_EUDEV_RULES_GEN=y
BR2_PACKAGE_EVTEST=y
BR2_PACKAGE_FWUPD=y
BR2_PACKAGE_FWUPD_EFI=y
BR2_PACKAGE_HDDTEMP=y
BR2_PACKAGE_HDPARM=y
BR2_PACKAGE_HWDATA=y
BR2_PACKAGE_I2C_TOOLS=y
BR2_PACKAGE_IOTOOLS=y
BR2_PACKAGE_KBD=y
BR2_PACKAGE_LM_SENSORS=y
BR2_PACKAGE_MEMTOOL=y
BR2_PACKAGE_PCIUTILS=y
BR2_PACKAGE_POWERTOP=y
BR2_PACKAGE_PPS_TOOLS=y
BR2_PACKAGE_USBMOUNT=y
BR2_PACKAGE_USBUTILS=y
BR2_PACKAGE_PYTHON_PIP=y
BR2_PACKAGE_MPFR=y
BR2_PACKAGE_BC=y
BR2_PACKAGE_AARDVARK_DNS=y
BR2_PACKAGE_CHRONY=y
BR2_PACKAGE_DHCP=y
BR2_PACKAGE_DHCPCD=y
BR2_PACKAGE_EASYFRAMES=y
BR2_PACKAGE_ETHTOOL=y
BR2_PACKAGE_IFPLUGD=y
BR2_PACKAGE_IPERF3=y
BR2_PACKAGE_IPTABLES=y
BR2_PACKAGE_IPUTILS=y
BR2_PACKAGE_LINUXPTP=y
BR2_PACKAGE_NET_TOOLS=y
BR2_PACKAGE_NETCAT=y
BR2_PACKAGE_NGINX=y
BR2_PACKAGE_NGINX_THREADS=y
BR2_PACKAGE_NGINX_HTTP_SSL_MODULE=y
BR2_PACKAGE_NGINX_HTTP_V2_MODULE=y
BR2_PACKAGE_NGINX_HTTP_REALIP_MODULE=y
BR2_PACKAGE_NGINX_HTTP_ADDITION_MODULE=y
BR2_PACKAGE_NGINX_HTTP_XSLT_MODULE=y
BR2_PACKAGE_NGINX_HTTP_IMAGE_FILTER_MODULE=y
BR2_PACKAGE_NGINX_HTTP_GEOIP_MODULE=y
BR2_PACKAGE_NGINX_HTTP_SUB_MODULE=y
BR2_PACKAGE_NGINX_HTTP_DAV_MODULE=y
BR2_PACKAGE_NGINX_HTTP_FLV_MODULE=y
BR2_PACKAGE_NGINX_HTTP_MP4_MODULE=y
BR2_PACKAGE_NGINX_HTTP_GUNZIP_MODULE=y
BR2_PACKAGE_NGINX_HTTP_GZIP_STATIC_MODULE=y
BR2_PACKAGE_NGINX_HTTP_AUTH_REQUEST_MODULE=y
BR2_PACKAGE_NGINX_HTTP_RANDOM_INDEX_MODULE=y
BR2_PACKAGE_NGINX_HTTP_SECURE_LINK_MODULE=y
BR2_PACKAGE_NGINX_HTTP_DEGRADATION_MODULE=y
BR2_PACKAGE_NGINX_HTTP_SLICE_MODULE=y
BR2_PACKAGE_NGINX_HTTP_STUB_STATUS_MODULE=y
BR2_PACKAGE_NGINX_DEBUG=y
BR2_PACKAGE_NGINX_SELECT_MODULE=y
BR2_PACKAGE_NGINX_POLL_MODULE=y
BR2_PACKAGE_NGINX_DAV_EXT=y
BR2_PACKAGE_NGINX_MODSECURITY=y
BR2_PACKAGE_NGINX_NAXSI=y
BR2_PACKAGE_NGINX_UPLOAD=y
BR2_PACKAGE_NTP=y
BR2_PACKAGE_OPENSSH=y
BR2_PACKAGE_TCPDUMP=y
BR2_PACKAGE_WGET=y
BR2_PACKAGE_WIRESHARK=y
# BR2_PACKAGE_WIRESHARK_GUI is not set
BR2_PACKAGE_BASH_LOADABLE_EXAMPLES=y
BR2_PACKAGE_BASH_COMPLETION=y
BR2_PACKAGE_NEOFETCH=y
BR2_PACKAGE_TMUX=y
BR2_PACKAGE_WHICH=y
BR2_PACKAGE_HTOP=y
BR2_PACKAGE_KMOD_TOOLS=y
BR2_PACKAGE_UTIL_LINUX_AGETTY=y
BR2_PACKAGE_UTIL_LINUX_FSCK=y
BR2_PACKAGE_UTIL_LINUX_MOUNT=y
BR2_PACKAGE_UTIL_LINUX_SULOGIN=y
BR2_PACKAGE_LESS=y
BR2_PACKAGE_MOST=y
BR2_PACKAGE_VIM=y
BR2_TARGET_ROOTFS_CPIO=y
BR2_TARGET_ROOTFS_CPIO_GZIP=y
BR2_TARGET_ROOTFS_EXT2=y
BR2_TARGET_ROOTFS_EXT2_4=y
BR2_TARGET_ROOTFS_EXT2_SIZE="2G"
BR2_TARGET_ROOTFS_TAR_GZIP=y
BR2_PACKAGE_HOST_KMOD=y
```
